## conf/layer.conf
```bitbake
# We have a conf and classes directory, add to BBPATH
BBPATH .= ":${LAYERDIR}"

# We have recipes-* directories, add to BBFILES
BBFILES += "${LAYERDIR}/recipes-*/*/*.bb \
            ${LAYERDIR}/recipes-*/*/*.bbappend"

BBFILE_COLLECTIONS += "meta-tps_cicd"
BBFILE_PATTERN_meta-tps_cicd = "^${LAYERDIR}/"
BBFILE_PRIORITY_meta-tps_cicd = "6"

LAYERDEPENDS_meta-tps_cicd = "core"
LAYERSERIES_COMPAT_meta-tps_cicd = "kirkstone"
```
